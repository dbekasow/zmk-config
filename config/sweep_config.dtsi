#define BASE  0
#define GER   1
#define NUM   2
#define SYM   3
#define MATH  4
#define NAV   5
#define FUN   6	

&mt {
	tapping-term-ms = <160>;
	quick-tap-ms = <0>;
};

/ {
	chosen {
		zmk,battery = &vbatt;
	};
	
	vbatt: vbatt {
		compatible = "zmk,battery-nrf-vddh";
		label = "VBATT";
	};
};
