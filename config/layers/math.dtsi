/*
 * Math Layer Layout
 * -----------------
 */

math_layer {
	label = "Math";
	bindings = <
	// ---------------+---------------+---------------+---------------+---------------||---------------+---------------+---------------+---------------+---------------|
		&kp DE_PRCNT	&kp DE_MINUS	&kp DE_PLUS		&kp DE_BSLH		&kp DE_CARET	 &none			 &none			 &none			 &none			 &none 
	// ---------------+---------------+---------------+---------------+---------------||---------------+---------------+---------------+---------------+---------------|
		&kp DE_QMARK	&kp DE_LT		&kp DE_GT		&kp DE_EQUAL	&kp DE_TILDE	 &none			 &sk LSHFT		 &sk LCTRL		 &sk LALT		 &sk LGUI
	// ---------------+---------------+---------------+---------------+---------------||---------------+---------------+---------------+---------------+---------------|
		&kp DE_EXCL		&kp DE_SLASH	&kp DE_STAR		&kp DE_AMPS		&kp DE_SQT		 &none			 &none			 &none			 &none			 &none			
	// ---------------+---------------+---------------+---------------+---------------||---------------+---------------+---------------+---------------+---------------|
														&trans			&kp SPACE		 &none 			 &none
							        				 //---------------+---------------||---------------+---------------|
	>;
};
