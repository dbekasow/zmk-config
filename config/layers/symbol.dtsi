/*
 * Symbol Layer Layout
 * -------------------
 */

symbol_layer {
	label = "Symbol";
	bindings = <
	// ---------------+---------------+---------------+---------------+----------------||----------------+---------------+---------------+---------------+---------------|
		&none		    &none		    &none		    &none		    &none			  &kp DE_AT	  	   &kp DE_DLLR	   &kp DE_LBRC	   &kp DE_RBRC	   &kp DE_GRAVE	
	// ---------------+---------------+---------------+---------------+----------------||----------------+---------------+---------------+---------------+---------------|
		&sk LGUI	    &sk LALT	    &sk LCTRL	    &sk LSHFT	    &none			  &kp DE_SEMI	   &kp DE_COLON	   &kp DE_LPAR	   &kp DE_RPAR	   &kp DE_PIPE
	// ---------------+---------------+---------------+---------------+----------------||----------------+---------------+---------------+---------------+---------------|
		&none		    &none		    &none		    &none		    &none			  &kp DE_UNDER	   &kp DE_AMPS	   &kp DE_LBKT 	   &kp DE_RBKT	   &kp DE_HASH
	// ---------------+---------------+---------------+---------------+----------------||----------------+---------------+---------------+---------------+---------------|
														&none		   &none	 		 &trans 			&trans
							        				 //---------------+----------------||----------------+---------------|
	>;
};
