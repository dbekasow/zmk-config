/*
 * Mirror Layer Layout
 * -------------------
 */

mirror_layer {
    label = "Mirror";
    bindings = <
    // ---------------+---------------+----------------+----------------+--------------||---------------+---------------+---------------+---------------+---------------|
        &sqtexcl        &dqtques        &slashamps       &dotcolon        &hashat         &none           &none           &none           &none           &none
    // ---------------+---------------+----------------+----------------+--------------||---------------+---------------+---------------+---------------+---------------|
        &hmp LGUI DE_H  &hmr LALT DE_I  &hmm LCTRL DE_E  &hmi LSHFT DE_A  &ad_comasemi    &none           &none           &none           &none           &none
    // ---------------+---------------+----------------+----------------+--------------||---------------+---------------+---------------+---------------+---------------|
        &kp DE_F        &hmr RALT DE_Y  &kp DE_O         &kp DE_U         &ad_minsunds    &none           &none           &none           &none           &none
    // ---------------+---------------+----------------+----------------+--------------||---------------+---------------+---------------+---------------+---------------|
                                                         &kp BSPC         &kp RET         &none           &none
                                                      //----------------+--------------||---------------+---------------|
    >;
};
