/*
 * Base Layer Layout
 * -----------------
 */

base_layer {
	label = "Base";
	bindings = <
	// ---------------+---------------+----------------+----------------+--------------||---------------+---------------+---------------+---------------+---------------|
		&kp DE_X		&ad_w   		&ad_m   	     &ad_g  		  &ad_j     	  &hashat		  &dotcolon		  &slashamps	  &dqtques	 	  &sqtexcl
	// ---------------+---------------+----------------+----------------+--------------||---------------+---------------+---------------+---------------+---------------|
		&hmp LGUI DE_S	&hmr LALT DE_C	&hmm LCTRL DE_N	 &hmi LSHFT DE_T  &ad_k 		  &ad_comasemi	  &hmi LSHFT DE_A &hmm LCTRL DE_E &hmr LALT DE_I  &hmp LGUI DE_H
	// ---------------+---------------+----------------+----------------+--------------||---------------+---------------+---------------+---------------+---------------|
		&ad_v   		&hmr RALT DE_P	&ad_l   		 &kp DE_D  		  &ad_b 		  &ad_minsunds	  &kp DE_U 		  &kp DE_O 		  &hmr RALT DE_Y  &kp DE_F	
	// ---------------+---------------+----------------+----------------+--------------||---------------+---------------+---------------+---------------+---------------|
														 &lt SYM BSPC	  &lt NUM DE_R	  &lt NAV SPACE	  &lt MATH RET
							        				  //----------------+--------------||---------------+---------------|
	>;
};
