/*
 * Function Layer Layout
 * ---------------------
 */
function_layer {
	label = "Function";
	bindings = <
	// ---------------+---------------+----------------+----------------+--------------||---------------+---------------+---------------+---------------+---------------|
		&kp F12			&kp F11			&kp F10			 &kp F9	 		  &kp PSCRN 	  &none			  &none			  &none			  &none			  &none		
	// ---------------+---------------+----------------+----------------+--------------||---------------+---------------+---------------+---------------+---------------|
		&kp F8			&kp F7 			&kp F6			 &kp F5			  &kp PAUSE_BREAK &none 		  &sk LSHFT		  &sk LCTRL		  &sk LALT		  &sk LGUI		
	// ---------------+---------------+----------------+----------------+--------------||---------------+---------------+---------------+---------------+---------------|
		&kp F4			&kp F3			&kp F2			 &kp F1			  &kp SYSREQ	  &none			  &bt BT_PRV	  &bt BT_CLR	  &bt BT_NXT 	  &none		
	// ---------------+---------------+----------------+----------------+--------------||---------------+---------------+---------------+---------------+---------------|
														 &none			  &none			  &none			  &none
							        				  //----------------+--------------||---------------+---------------|
	>;
};
