/*
 * Number Layer Layout
 * -------------------
 */

number_layer {
	label = "Number";
	bindings = <
	// ---------------+---------------+----------------+----------------+--------------||---------------+---------------+---------------+---------------+---------------|
		&kp DE_PRCNT	&kp DE_DEG		&kp DE_COMMA	 &kp DE_DOT		  &none			  &kp DE_SLASH	  &kp DE_7		  &kp DE_8		  &kp DE_9		  &kp DE_MINUS 
	// ---------------+---------------+----------------+----------------+--------------||---------------+---------------+---------------+---------------+---------------|
		&sk LGUI		&sk LALT		&sk LCTRL		 &sk LSHFT		  &none			  &kp DE_STAR	  &kp DE_4		  &kp DE_5		  &kp DE_6		  &kp DE_PLUS
	// ---------------+---------------+----------------+----------------+--------------||---------------+---------------+---------------+---------------+---------------|
		&kp DE_SUP3		&kp DE_SUP2		&kp DE_DLLR		 &kp DE_EURO	  &none			  &kp DE_0	   	  &kp DE_1		  &kp DE_2		  &kp DE_3		  &kp DE_EQUAL	
	// ---------------+---------------+----------------+----------------+--------------||---------------+---------------+---------------+---------------+---------------|
														 &none			  &none			  &trans		  &trans
							        				  //----------------+--------------||---------------+---------------|
	>;
};
