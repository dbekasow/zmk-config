
/*
 * Navigation Layer Layout
 * -----------------------
 */

navigation_layer {
	label = "Navigation";
	bindings = <
	// ---------------+---------------+----------------+----------------+--------------||---------------+---------------+---------------+---------------+---------------|
		&caps_word		&kp HOME		&kp UP			 &kp END		  &td_pg_up_base  &none			  &none			  &none			  &none			  &none 
	// ---------------+---------------+----------------+----------------+--------------||---------------+---------------+---------------+---------------+---------------|
		&kp ESC 		&kp LEFT		&kp DOWN		 &kp RIGHT		  &kp PG_DN		  &none			  &sk LSHFT		  &sk LCTRL 	  &sk LALT		  &sk LGUI
	// ---------------+---------------+----------------+----------------+--------------||---------------+---------------+---------------+---------------+---------------|
		&kp LC(Z)		&kp LC(X)		&kp LC(C)		 &kp LC(V)		  &kp K_APP		  &none	    	  &none			  &none			  &none			  &none	
	// ---------------+---------------+----------------+----------------+--------------||---------------+---------------+---------------+---------------+---------------|
														 &kp DEL		  &lt FUN TAB	  &none			&none
							        				  //----------------+--------------||---------------+---------------|
	>;
};
